## software/firmware/main/Kconfig.projbuild
```kconfig
menu "Raidmaster 403"

    choice RAIDMASTER_LCD_ROTATION
        prompt "Sens de l'écran (UI paysage sur le panneau portrait)"
        default RAIDMASTER_LCD_ROTATION_90
        help
            L'UI 480 × 320 est tournée par logiciel vers le panneau natif 320 × 480. À changer si
            l'image (et le tactile) apparaissent à l'envers dans le sens de montage voulu.

        config RAIDMASTER_LCD_ROTATION_90
            bool "90° (sens horaire)"
        config RAIDMASTER_LCD_ROTATION_270
            bool "270°"
    endchoice

    config RAIDMASTER_LCD_PCLK_MHZ
        int "Horloge QSPI de l'écran (MHz)"
        range 10 80
        default 40
        help
            40 MHz comme les exemples Waveshare. Plus haut : images plus rapides, à valider sur la
            carte (parasites, image corrompue).

    config RAIDMASTER_BACKLIGHT_DAY
        int "Rétroéclairage de jour (%)"
        range 5 100
        default 100

    config RAIDMASTER_BACKLIGHT_NIGHT
        int "Rétroéclairage de nuit (%)"
        range 1 100
        default 30

    config RAIDMASTER_AUDIO_VOLUME
        int "Volume du haut-parleur (codec ES8311, 0 à 100)"
        range 0 100
        default 70
        help
            Volume de sortie du codec pour tous les sons (jingle de démarrage…), avec le HP 6 Ω
            1 W sur l'ampli NS4150B. À régler à l'oreille sur la carte ; 0 coupe le son.

    config RAIDMASTER_TOUCH_BUTTONS
        bool "Tactile en guise de boutons (banc, sans carte boutons)"
        default y
        help
            L'écran est découpé en 5 bandes verticales, de gauche à droite : A, B, −, +, Menu.
            Appui court au relâchement, appui long après 800 ms de maintien. Pour essayer l'UI
            au banc tant que la carte boutons n'existe pas.

    choice RAIDMASTER_GPS_SOURCE
        prompt "Source GPS"
        default RAIDMASTER_GPS_DEMO
        help
            Trajet simulé (démonstration, sans récepteur) ou récepteur u-blox réel sur un UART :
            NEO-M9N de la carte fille ou puck de drone NEO-M8N (sur le J8 de la Waveshare seule :
            TX du puck sur la broche 17 = IO18, RX sur la broche 15 = IO17). Le récepteur est
            reconnu (MON-VER) et réglé à chaque démarrage.

        config RAIDMASTER_GPS_DEMO
            bool "Démonstration (trajet simulé)"
        config RAIDMASTER_GPS_UART
            bool "Récepteur u-blox sur UART (M9N ou puck M8N)"
    endchoice

    if RAIDMASTER_GPS_UART

    config RAIDMASTER_GPS_UART_NUM
        int "UART du récepteur"
        range 1 2
        default 1

    config RAIDMASTER_GPS_TX_GPIO
        int "GPIO TX de l'ESP32 (vers RXD du récepteur)"
        range 0 48
        default 17

    config RAIDMASTER_GPS_RX_GPIO
        int "GPIO RX de l'ESP32 (depuis TXD du récepteur)"
        range 0 48
        default 18

    config RAIDMASTER_GPS_EN_GPIO
        int "GPIO d'allumage du régulateur GNSS (-1 : aucun)"
        range -1 48
        default 45
        help
            EN de l'AP2112K de la carte fille (IO45, broche de strapping tirée au 0 au démarrage :
            le GPS s'allume quand le firmware la met à 1). Sans effet sur la Waveshare seule.

    config RAIDMASTER_GPS_BAUD
        int "Débit voulu après réglage (bauds)"
        range 9600 921600
        default 115200
        help
            Le firmware cherche le récepteur à 115 200, 38 400 puis 9 600 bauds, puis le passe à ce
            débit (non enregistré dans le récepteur : il reprend son débit d'usine à la coupure).

    config RAIDMASTER_GPS_RATE_HZ
        int "Cadence des positions (Hz)"
        range 1 10
        default 10
        help
            10 Hz : maximum du M8N en GPS + GLONASS ; à vérifier au banc en multi-constellation.

    endif

    config RAIDMASTER_COMPASS
        bool "Boussole du puck sur I2C1"
        default RAIDMASTER_GPS_UART
        help
            Magnétomètre du puck (QMC5883L, IST8310, HMC5883L ou LIS3MDL, reconnu seul) sur le bus
            I2C1. Sur le J8 de la Waveshare seule : SDA du puck sur la broche 10 (IO39), SCL sur la
            broche 12 (IO40). Cap à l'écran après calibration (menu « Calibration boussole »),
            cap brut dans le journal.

    if RAIDMASTER_COMPASS

    config RAIDMASTER_COMPASS_SDA_GPIO
        int "GPIO SDA de l'I2C1"
        range 0 48
        default 39

    config RAIDMASTER_COMPASS_SCL_GPIO
        int "GPIO SCL de l'I2C1"
        range 0 48
        default 40

    config RAIDMASTER_COMPASS_YAW
        int "Rotation de la boussole par rapport à la flèche du puck (0, 90, 180, 270°)"
        range 0 270
        default 0
        help
            Comme COMPASS_ORIENT d'ArduPilot (rotation en lacet, sens horaire vu de dessus). À
            régler au banc : flèche du puck vers le nord, le cap lu doit valoir ~0°.

    config RAIDMASTER_COMPASS_FLIPPED
        bool "Boussole à l'envers (puce vers le bas)"
        default n

    config RAIDMASTER_COMPASS_LOG_S
        int "Journal du cap, toutes les N secondes (0 : changements d'état seulement)"
        range 0 60
        default 1

    endif

endmenu
```
